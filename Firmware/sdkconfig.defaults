## Firmware/sdkconfig.defaults
```kconfig
# Flash 16MB
CONFIG_ESPTOOLPY_FLASHSIZE_16MB=y
CONFIG_ESPTOOLPY_FLASHSIZE="16MB"

# Custom partition
CONFIG_PARTITION_TABLE_CUSTOM=y
CONFIG_PARTITION_TABLE_CUSTOM_FILENAME="partitions.csv"
CONFIG_PARTITION_TABLE_FILENAME="partitions.csv"
CONFIG_PARTITION_TABLE_OFFSET=0x8000

# PSRAM 8MB
CONFIG_SPIRAM=y
CONFIG_SPIRAM_MODE_OCT=y
CONFIG_SPIRAM_SPEED_80M=y

# Websocket support
CONFIG_HTTPD_WS_SUPPORT=y

# Bluetooth support
CONFIG_BT_ENABLED=y
CONFIG_BT_NIMBLE_ENABLED=y
CONFIG_BT_NIMBLE_50_FEATURE_SUPPORT=n

# fix for long headers on android requests to captive portal
CONFIG_HTTPD_MAX_REQ_HDR_LEN=1024

# Increase FreeRTOS scheduler update rate
CONFIG_FREERTOS_HZ=1000

# Increase the max number of open sockets
CONFIG_LWIP_MAX_SOCKETS=24

# Enable task stats for CPU usage
CONFIG_FREERTOS_GENERATE_RUN_TIME_STATS=y
CONFIG_FREERTOS_USE_STATS_FORMATTING_FUNCTIONS=y

# Enable OV2640 support in esp32-camera module
CONFIG_OV2640_SUPPORT=y
```
